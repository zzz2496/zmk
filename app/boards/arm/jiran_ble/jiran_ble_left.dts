/*
 * Copyright (c) 2021 The ZMK Contributors
 *
 * SPDX-License-Identifier: MIT
 */

#include "jiran_ble.dtsi"

&kscan0 {
    row-gpios
        = <&gpio0 23 (GPIO_ACTIVE_HIGH | GPIO_PULL_DOWN)>
        , <&gpio0 21 (GPIO_ACTIVE_HIGH | GPIO_PULL_DOWN)>
        , <&gpio0 19 (GPIO_ACTIVE_HIGH | GPIO_PULL_DOWN)>
        , <&gpio1  3 (GPIO_ACTIVE_HIGH | GPIO_PULL_DOWN)>
        , <&gpio1  1 (GPIO_ACTIVE_HIGH | GPIO_PULL_DOWN)>
        ;

    col-gpios
        = <&gpio0  3 GPIO_ACTIVE_HIGH>
        , <&gpio0  2 GPIO_ACTIVE_HIGH>
        , <&gpio0 28 GPIO_ACTIVE_HIGH>
        , <&gpio0 29 GPIO_ACTIVE_HIGH>
        , <&gpio0 30 GPIO_ACTIVE_HIGH>
        , <&gpio0 31 GPIO_ACTIVE_HIGH>
        ;
};