## app/boards/arm/jiran_ble/Kconfig.board
```kconfig
# Jiran BLE board configuration

# Copyright (c) 2021 The ZMK Contributors
# SPDX-License-Identifier: MIT

config BOARD_JIRAN_BLE_LEFT
	bool "jiran_ble_left"
	depends on SOC_NRF52840_QIAA

config BOARD_JIRAN_BLE_RIGHT
	bool "jiran_ble_right"
	depends on SOC_NRF52840_QIAA
```

## app/boards/arm/jiran_ble/Kconfig.defconfig
```kconfig
# Copyright (c) 2021 The ZMK Contributors
# SPDX-License-Identifier: MIT

if BOARD_JIRAN_BLE_LEFT

	config ZMK_KEYBOARD_NAME
	default "Jiran BLE"

endif # BOARD_JIRAN_BLE_LEFT

if BOARD_JIRAN_BLE_RIGHT

	config ZMK_KEYBOARD_NAME
	default "Jiran BLE (right)"

endif # BOARD_JIRAN_BLE_RIGHT


if BOARD_JIRAN_BLE_LEFT || BOARD_JIRAN_BLE_RIGHT

config BOARD
	default "jiran_ble"

config ZMK_SPLIT
	default y

menuconfig SENSOR
    bool "Sensor Drivers"

config BT_CTLR
	default BT

config ZMK_BLE
	default y

config ZMK_USB
	default y

config ZMK_BATTERY_VOLTAGE_DIVIDER  # is this correct?
	default y

if USB

config USB_NRFX
	default y

config USB_DEVICE_STACK
	default y

endif # USB

endif # BOARD_JIRAN_BLE_LEFT || BOARD_JIRAN_BLE_RIGHT
```

## app/drivers/zephyr/dts/bindings/kscan/zmk,kscan-gpio-matrix.yaml
```yaml
# Copyright (c) 2020, Pete Johanson
# SPDX-License-Identifier: MIT

description: GPIO keyboard matrix controller

compatible: "zmk,kscan-gpio-matrix"

include: kscan.yaml

properties:
  row-gpios:
    type: phandle-array
    required: true
  col-gpios:
    type: phandle-array
    required: true
  debounce-period:
    type: int
    required: false
    deprecated: true
    description: Deprecated. Use debounce-press-ms and debounce-release-ms instead.
  debounce-press-ms:
    type: int
    default: 5
    description: Debounce time for key press in milliseconds. Use 0 for eager debouncing.
  debounce-release-ms:
    type: int
    default: 5
    description: Debounce time for key release in milliseconds.
  poll-period-ms:
    type: int
    default: 10
    description:
      Time between reads in milliseconds when polling is enabled and no key is pressed.
      (Polling automatically switches to 1 ms when any key is pressed.)
  diode-direction:
    type: string
    default: row2col
    enum:
      - row2col
      - col2row
```

## app/dts/bindings/behaviors/zmk,behavior-mouse-event.yaml
```yaml
# Copyright (c) 2020 The ZMK Contributors
# SPDX-License-Identifier: MIT

description: Mouse press or move

compatible: "zmk,behavior-mouse-event"

include: one_param.yaml
```
